`timescale 1ns/1ps

module tb_audio_ctrl_apb_phase3;

    localparam int SAMPLE_WIDTH = 24;
    localparam int SLOT_WIDTH   = 32;
    localparam int FIFO_DEPTH   = 16;
    localparam int PCLK_FREQ_HZ = 50_000_000;
    localparam int I2S_WS_HZ    = 16_000;
    localparam int I2S_SCK_HZ   = I2S_WS_HZ * 64;

    localparam logic [11:0] ADDR_CTRL       = 12'h000;
    localparam logic [11:0] ADDR_STATUS     = 12'h004;
    localparam logic [11:0] ADDR_DATA       = 12'h008;
    localparam logic [11:0] ADDR_FIFO_LEVEL = 12'h00C;

    // ------------------------------------------------------------------------
    // Clocks / Reset
    // ------------------------------------------------------------------------
    logic pclk;
    logic rst_n;

    // I2S SCK is derived from pclk by divider logic.
    logic i2s_sck;
    int   i2s_div_acc;

    // ------------------------------------------------------------------------
    // APB signals
    // ------------------------------------------------------------------------
    logic        psel;
    logic        penable;
    logic        pwrite;
    logic [11:0] paddr;
    logic [31:0] pwdata;
    logic [31:0] prdata;
    logic        pready;
    logic        pslverr;

    // ------------------------------------------------------------------------
    // I2S pins and i2s_rx_core outputs
    // ------------------------------------------------------------------------
    logic i2s_ws;
    logic i2s_sd;

    wire [23:0] i2s_sample_data;
    wire        i2s_sample_valid;

    // ------------------------------------------------------------------------
    // DUT outputs
    // ------------------------------------------------------------------------
    wire        fifo_empty;
    wire        fifo_full;
    wire [15:0] fifo_level;

    // ------------------------------------------------------------------------
    // Scoreboard / counters
    // ------------------------------------------------------------------------
    int error_cnt;
    int pass_cnt;

    logic [23:0] exp_q[$];

    // ------------------------------------------------------------------------
    // Clock generation
    // ------------------------------------------------------------------------
    initial begin
        pclk = 1'b0;
        forever #10 pclk = ~pclk;
    end

    // Fractional divider: derive i2s_sck from pclk with average 1.024 MHz.
    // Toggle rate target is 2 * i2s_sck, generated by accumulator thresholding.
    always @(posedge pclk or negedge rst_n) begin
        if (!rst_n) begin
            i2s_sck     <= 1'b0;
            i2s_div_acc <= 0;
        end else begin
            if ((i2s_div_acc + (2 * I2S_SCK_HZ)) >= PCLK_FREQ_HZ) begin
                i2s_div_acc <= i2s_div_acc + (2 * I2S_SCK_HZ) - PCLK_FREQ_HZ;
                i2s_sck     <= ~i2s_sck;
            end else begin
                i2s_div_acc <= i2s_div_acc + (2 * I2S_SCK_HZ);
            end
        end
    end

    // ------------------------------------------------------------------------
    // Reset
    // ------------------------------------------------------------------------
    initial begin
        rst_n    = 1'b0;
        psel     = 1'b0;
        penable  = 1'b0;
        pwrite   = 1'b0;
        paddr    = 12'h000;
        pwdata   = 32'h0;
        i2s_ws   = 1'b1;
        i2s_sd   = 1'b0;
        error_cnt = 0;
        pass_cnt  = 0;

        repeat (6) @(posedge pclk);
        rst_n = 1'b1;
    end

    // ------------------------------------------------------------------------
    // Instantiate i2s_rx_core (verified in Phase2)
    // ------------------------------------------------------------------------
    i2s_rx_core #(
        .SAMPLE_WIDTH (SAMPLE_WIDTH),
        .SLOT_WIDTH   (SLOT_WIDTH),
        .WS_POL_LEFT  (1'b0)
    ) u_i2s_rx_core (
        .rst_n        (rst_n),
        .i2s_sck      (i2s_sck),
        .i2s_ws       (i2s_ws),
        .i2s_sd       (i2s_sd),
        .sample_data  (i2s_sample_data),
        .sample_valid (i2s_sample_valid)
    );

    // ------------------------------------------------------------------------
    // Instantiate DUT
    // ------------------------------------------------------------------------
    audio_ctrl_apb #(
        .FIFO_DEPTH(FIFO_DEPTH)
    ) u_dut (
        .pclk        (pclk),
        .presetn     (rst_n),
        .psel        (psel),
        .penable     (penable),
        .pwrite      (pwrite),
        .paddr       (paddr),
        .pwdata      (pwdata),
        .prdata      (prdata),
        .pready      (pready),
        .pslverr     (pslverr),
        .sample_valid(i2s_sample_valid),
        .sample_data (i2s_sample_data),
        .fifo_empty  (fifo_empty),
        .fifo_full   (fifo_full),
        .fifo_level  (fifo_level)
    );

    // ------------------------------------------------------------------------
    // Common helpers
    // ------------------------------------------------------------------------
    task automatic fail(input string msg);
        begin
            error_cnt = error_cnt + 1;
            $display("[FAIL][%0t] %s", $time, msg);
        end
    endtask

    task automatic pass(input string msg);
        begin
            pass_cnt = pass_cnt + 1;
            $display("[PASS][%0t] %s", $time, msg);
        end
    endtask

    task automatic check_eq32(input string tag, input logic [31:0] got, input logic [31:0] exp);
        begin
            if (got !== exp)
                fail($sformatf("%s: got=0x%08h exp=0x%08h", tag, got, exp));
            else
                pass($sformatf("%s = 0x%08h", tag, got));
        end
    endtask

    task automatic check_eq16(input string tag, input logic [15:0] got, input logic [15:0] exp);
        begin
            if (got !== exp)
                fail($sformatf("%s: got=0x%04h exp=0x%04h", tag, got, exp));
            else
                pass($sformatf("%s = 0x%04h", tag, got));
        end
    endtask

    task automatic apb_idle();
        begin
            @(negedge pclk);
            psel    <= 1'b0;
            penable <= 1'b0;
            pwrite  <= 1'b0;
            paddr   <= 12'h000;
            pwdata  <= 32'h0;
        end
    endtask

    task automatic apb_write(input logic [11:0] addr, input logic [31:0] data);
        begin
            @(negedge pclk);
            psel    <= 1'b1;
            penable <= 1'b0;
            pwrite  <= 1'b1;
            paddr   <= addr;
            pwdata  <= data;

            @(negedge pclk);
            penable <= 1'b1;

            @(negedge pclk);
            psel    <= 1'b0;
            penable <= 1'b0;
            pwrite  <= 1'b0;
            paddr   <= 12'h000;
            pwdata  <= 32'h0;
        end
    endtask

    task automatic apb_read(input logic [11:0] addr, output logic [31:0] data);
        begin
            @(negedge pclk);
            psel    <= 1'b1;
            penable <= 1'b0;
            pwrite  <= 1'b0;
            paddr   <= addr;
            pwdata  <= 32'h0;

            @(negedge pclk);
            penable <= 1'b1;
            #1;
            data = prdata;

            @(negedge pclk);
            psel    <= 1'b0;
            penable <= 1'b0;
            paddr   <= 12'h000;
        end
    endtask

    task automatic drive_i2s_slot(
        input logic ws_level,
        input logic [23:0] left_sample,
        input bit drive_left,
        inout int valid_seen,
        inout logic [23:0] observed
    );
        int cyc;
        int bit_idx;
        begin
            // Update WS on SCK low phase so next SCK posedge can sample WS edge.
            @(negedge i2s_sck);
            i2s_ws <= ws_level;

            for (cyc = 0; cyc < SLOT_WIDTH; cyc++) begin

                if (drive_left && (ws_level == 1'b0) && (cyc > 0) && (cyc <= SAMPLE_WIDTH)) begin
                    bit_idx = SAMPLE_WIDTH - cyc;
                    i2s_sd <= left_sample[bit_idx];
                end else begin
                    i2s_sd <= 1'b0;
                end

                @(posedge i2s_sck);
                if (i2s_sample_valid) begin
                    valid_seen = valid_seen + 1;
                    observed   = i2s_sample_data;
                end
            end
        end
    endtask

    task automatic i2s_startup_sync();
        begin
            // Ensure ws_d1 in i2s_rx_core observes WS=1 on valid SCK edges
            // before first WS falling edge.
            i2s_ws <= 1'b1;
            i2s_sd <= 1'b0;
            repeat (3) @(posedge i2s_sck);
        end
    endtask

    task automatic send_one_left_sample(input logic [23:0] tx_sample);
        int valid_seen;
        logic [23:0] observed;
        begin
            valid_seen = 0;
            observed   = 24'h0;

            if (i2s_ws !== 1'b1)
                drive_i2s_slot(1'b1, 24'h0, 1'b0, valid_seen, observed);

            drive_i2s_slot(1'b0, tx_sample, 1'b1, valid_seen, observed);
            drive_i2s_slot(1'b1, 24'h0, 1'b0, valid_seen, observed);

            if (valid_seen != 1)
                fail($sformatf("i2s_rx_core sample_valid count mismatch, seen=%0d", valid_seen));
            else if (observed !== tx_sample)
                fail($sformatf("i2s_rx_core sample mismatch: tx=0x%06h rx=0x%06h", tx_sample, observed));
            else
                pass($sformatf("i2s left-channel sample accepted: 0x%06h", tx_sample));
        end
    endtask

    task automatic read_status(output logic [31:0] status);
        begin
            apb_read(ADDR_STATUS, status);
        end
    endtask

    task automatic read_level(output logic [31:0] level_reg);
        begin
            apb_read(ADDR_FIFO_LEVEL, level_reg);
        end
    endtask

    task automatic pop_and_check_data(input logic [23:0] exp_sample);
        logic [31:0] rdata;
        begin
            apb_read(ADDR_DATA, rdata);
            check_eq32("DATA pop", rdata, {8'h00, exp_sample});
        end
    endtask

    // Constant-output checker
    always @(posedge pclk) begin
        if (rst_n) begin
            if (pready !== 1'b1)
                fail($sformatf("pready must stay 1, got %b", pready));
            if (pslverr !== 1'b0)
                fail($sformatf("pslverr must stay 0, got %b", pslverr));
        end
    end

    // ------------------------------------------------------------------------
    // Main test sequence
    // ------------------------------------------------------------------------
    initial begin : main_test
        logic [31:0] rdata;
        logic [31:0] status;
        logic [31:0] level_reg;
        logic [23:0] s;
        int i;

        if ($test$plusargs("DUMPVCD")) begin
            $dumpfile("phase3_audio_ctrl_apb_tb.vcd");
            $dumpvars(0, tb_audio_ctrl_apb_phase3);
        end

        wait (rst_n == 1'b1);
        apb_idle();
        i2s_startup_sync();
        repeat (2) @(posedge pclk);

        $display("\n========== CASE0: Reset defaults ==========");
        apb_read(ADDR_CTRL, rdata);
        check_eq32("CTRL after reset", rdata, 32'h0000_0000);

        read_status(status);
        check_eq32("STATUS after reset", status, 32'h0000_0001);

        read_level(level_reg);
        check_eq32("FIFO_LEVEL after reset", level_reg, 32'h0000_0000);
        check_eq16("fifo_level port after reset", fifo_level, 16'h0000);

        $display("\n========== CASE1: fifo_en=0 should block captures ==========");
        for (i = 0; i < 4; i++) begin
            s = $urandom;
            send_one_left_sample(s);
        end

        read_level(level_reg);
        check_eq32("FIFO_LEVEL while fifo_en=0", level_reg, 32'h0000_0000);
        read_status(status);
        check_eq32("STATUS while fifo_en=0", status & 32'h1F, 32'h0000_0001);

        $display("\n========== CASE2: Enable capture and read back in order ==========");
        apb_write(ADDR_CTRL, 32'h0000_0001);
        apb_read(ADDR_CTRL, rdata);
        check_eq32("CTRL fifo_en set", rdata, 32'h0000_0001);

        exp_q.delete();
        for (i = 0; i < 6; i++) begin
            s = $urandom;
            exp_q.push_back(s);
            send_one_left_sample(s);
        end

        read_level(level_reg);
        check_eq32("FIFO_LEVEL after 6 pushes", level_reg, 32'h0000_0006);

        read_status(status);
        if (status[4] !== 1'b1)
            fail($sformatf("STATUS.data_ready must be 1, status=0x%08h", status));
        else
            pass("STATUS.data_ready asserted");

        for (i = 0; i < 6; i++) begin
            pop_and_check_data(exp_q[i]);
        end

        read_level(level_reg);
        check_eq32("FIFO_LEVEL after pops", level_reg, 32'h0000_0000);

        read_status(status);
        if (status[0] !== 1'b1 || status[4] !== 1'b0)
            fail($sformatf("STATUS empty/data_ready mismatch after drain, status=0x%08h", status));
        else
            pass("STATUS empty=1 and data_ready=0 after drain");

        $display("\n========== CASE3: Underflow + W1C ==========");
        apb_read(ADDR_DATA, rdata);
        check_eq32("DATA on empty FIFO", rdata, 32'h0000_0000);

        read_status(status);
        if (status[3] !== 1'b1)
            fail($sformatf("underflow must set after empty read, status=0x%08h", status));
        else
            pass("underflow set after empty read");

        apb_write(ADDR_STATUS, 32'h0000_0008);
        read_status(status);
        if (status[3] !== 1'b0)
            fail($sformatf("underflow W1C clear failed, status=0x%08h", status));
        else
            pass("underflow W1C clear success");

        $display("\n========== CASE4: Overflow + W1C ==========");
        apb_write(ADDR_CTRL, 32'h0000_0003); // fifo_en=1 + fifo_clr pulse
        apb_read(ADDR_CTRL, rdata);
        check_eq32("CTRL after clr pulse", rdata, 32'h0000_0001);

        exp_q.delete();
        for (i = 0; i < FIFO_DEPTH; i++) begin
            s = $urandom;
            exp_q.push_back(s);
            send_one_left_sample(s);
        end

        read_level(level_reg);
        check_eq32("FIFO_LEVEL at full", level_reg, FIFO_DEPTH);
        if (fifo_full !== 1'b1)
            fail("fifo_full output must assert at full depth");
        else
            pass("fifo_full output asserted");

        s = $urandom;
        send_one_left_sample(s);

        read_level(level_reg);
        check_eq32("FIFO_LEVEL stays full after overflow push", level_reg, FIFO_DEPTH);

        read_status(status);
        if (status[2] !== 1'b1)
            fail($sformatf("overflow must set when writing full FIFO, status=0x%08h", status));
        else
            pass("overflow set when FIFO is full");

        apb_write(ADDR_STATUS, 32'h0000_0004);
        read_status(status);
        if (status[2] !== 1'b0)
            fail($sformatf("overflow W1C clear failed, status=0x%08h", status));
        else
            pass("overflow W1C clear success");

        $display("\n========== CASE5: STATUS W1C same-cycle set priority (overflow) ==========");
        // Keep FIFO full and issue W1C while injecting a new sample_valid rise in same clock.
        force i2s_sample_data  = 24'h55AA33;
        force i2s_sample_valid = 1'b0;
        @(posedge pclk);

        @(negedge pclk);
        psel    <= 1'b1;
        penable <= 1'b1;
        pwrite  <= 1'b1;
        paddr   <= ADDR_STATUS;
        pwdata  <= 32'h0000_0004;
        force i2s_sample_valid = 1'b1;

        @(posedge pclk);

        @(negedge pclk);
        psel    <= 1'b0;
        penable <= 1'b0;
        pwrite  <= 1'b0;
        paddr   <= 12'h000;
        pwdata  <= 32'h0;
        force i2s_sample_valid = 1'b0;
        release i2s_sample_valid;
        release i2s_sample_data;

        read_status(status);
        if (status[2] !== 1'b1)
            fail($sformatf("hardware-set priority violated for overflow W1C conflict, status=0x%08h", status));
        else
            pass("overflow hardware-set priority over W1C verified");

        apb_write(ADDR_STATUS, 32'h0000_0004);

        $display("\n========== CASE6: fifo_clr should clear FIFO and preserve fifo_en ==========");
        apb_write(ADDR_CTRL, 32'h0000_0003);
        apb_read(ADDR_CTRL, rdata);
        check_eq32("CTRL after clear command", rdata, 32'h0000_0001);

        read_level(level_reg);
        check_eq32("FIFO_LEVEL after clear", level_reg, 32'h0000_0000);

        read_status(status);
        if (status[0] !== 1'b1 || status[4] !== 1'b0)
            fail($sformatf("STATUS mismatch after fifo_clr, status=0x%08h", status));
        else
            pass("fifo_clr reflected in STATUS");

        $display("\n========== CASE7: Undefined address behavior ==========");
        apb_write(12'h3FC, 32'hDEAD_BEEF);
        apb_read(12'h3FC, rdata);
        check_eq32("read undefined address", rdata, 32'h0000_0000);

        apb_read(ADDR_CTRL, rdata);
        check_eq32("CTRL unaffected by undefined write", rdata, 32'h0000_0001);

        $display("\n========== CASE8: sample_valid de-dup (stretched high pulse) ==========");
        apb_write(ADDR_CTRL, 32'h0000_0003); // clear
        apb_write(ADDR_CTRL, 32'h0000_0001); // enable

        force i2s_sample_data  = 24'h123456;
        force i2s_sample_valid = 1'b0;
        @(posedge pclk);
        force i2s_sample_valid = 1'b1;
        repeat (3) @(posedge pclk);
        force i2s_sample_valid = 1'b0;
        @(posedge pclk);
        release i2s_sample_valid;
        release i2s_sample_data;

        read_level(level_reg);
        check_eq32("FIFO_LEVEL after stretched sample_valid", level_reg, 32'h0000_0001);

        apb_read(ADDR_DATA, rdata);
        check_eq32("DATA after stretched sample_valid", rdata, 32'h0012_3456);

        apb_read(ADDR_FIFO_LEVEL, rdata);
        check_eq32("FIFO_LEVEL after de-dup read", rdata, 32'h0000_0000);

        $display("\n========== TEST SUMMARY ==========");
        $display("PASS count = %0d", pass_cnt);
        $display("FAIL count = %0d", error_cnt);

        if (error_cnt == 0)
            $display("TB RESULT: PASS");
        else
            $display("TB RESULT: FAIL");

        #20;
        $finish;
    end

endmodule
